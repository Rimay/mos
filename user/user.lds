ENTRY(_start)
SECTIONS
{
    . = 0x00040000;
    .text : {
        *(.text*)
    }
    .rodata : {
        *(.rodata*)
    }
    .data : {
        *(.data*)
    }
    .bss : {
        *(.bss*)
    }
    /DISCARD/ : {
        *(.comment)
        *(.debug_*)
	}
}